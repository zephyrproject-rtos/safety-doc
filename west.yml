## west.yml
```yaml
manifest:
  remotes:
    # short names for project URLs
    - name: zephyrproject-rtos
      url-base: https://github.com/zephyrproject-rtos
    - name: nashif
      url-base: https://github.com/nashif
  projects:
    - name: zephyr
      remote: nashif
      path: zephyr
      revision: topic/collab-safety
      import:
        name-allowlist:
          - cmsis      # required by the ARM port
    - name: reqmgmt
      remote: zephyrproject-rtos
      path: doc/reqmgmt
      revision: main
```
